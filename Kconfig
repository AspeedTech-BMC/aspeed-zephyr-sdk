## Kconfig
```kconfig
# Copyright (c) 2022 ASPEED Technology Inc.
# SPDX-License-Identifier: MIT

menu "Additional libraries"
rsource "modules/Kconfig"
rsource "lib/dmtf/Kconfig"
rsource "lib/smf/Kconfig"
rsource "lib/hrot_hal/Kconfig"
rsource "lib/hrot_wrapper/Kconfig"
endmenu
```

## apps/aspeed-pfr/boards/ast1060_evb.conf
```kconfig
CONFIG_GPIO_ASPEED_SGPIOM=y
CONFIG_GPIO_ASPEED=y
CONFIG_SPI_ASPEED=y
CONFIG_SPI_MONITOR_ASPEED=y
CONFIG_SPI_NOR_ADDR_MODE_FALLBACK_DISABLED=y
CONFIG_I2C_ASPEED=y
CONFIG_I2C_PFR=y
CONFIG_I2C_PFR_INIT_PRIORITY=60
CONFIG_I2C_PFR_FILTER=y
CONFIG_WATCHDOG=y
CONFIG_WDT_ASPEED=y
CONFIG_UART_ASPEED=y
CONFIG_PFR_SW_MAILBOX=y
CONFIG_I2C_SWMBX_SLAVE=y
CONFIG_SPI_MUX_INVERSE=y
CONFIG_BMC_STAGING_SIZE=0x2000000
CONFIG_BMC_PFR_STAGING_SIZE=0x100000
CONFIG_BMC_CPLD_STAGING_SIZE=0x400000
CONFIG_PCH_STAGING_SIZE=0x1000000
CONFIG_OTP_ASPEED=y
```

## apps/aspeed-pfr/boards/ast1060_prot.conf
```kconfig
CONFIG_FRONT_PANEL_LED=n
CONFIG_GPIO_ASPEED_SGPIOM=y
CONFIG_GPIO_ASPEED=y
CONFIG_SPI_ASPEED=y
CONFIG_SPI_MONITOR_ASPEED=y
CONFIG_SPI_NOR_ADDR_MODE_FALLBACK_DISABLED=y
CONFIG_I2C_ASPEED=y
CONFIG_I2C_PFR=y
CONFIG_I2C_PFR_INIT_PRIORITY=60
CONFIG_I2C_PFR_FILTER=y
CONFIG_WATCHDOG=y
CONFIG_WDT_ASPEED=y
CONFIG_UART_ASPEED=y
CONFIG_PFR_SW_MAILBOX=y
CONFIG_I2C_SWMBX_SLAVE=y
CONFIG_PLATFORM_STATE_LED=y
CONFIG_BMC_DUAL_FLASH=y
CONFIG_CPU_DUAL_FLASH=n
CONFIG_BMC_STAGING_SIZE=0x3de0000
CONFIG_BMC_PFR_STAGING_SIZE=0x100000
CONFIG_BMC_CPLD_STAGING_SIZE=0x400000
CONFIG_PCH_STAGING_SIZE=0x1000000

CONFIG_INTEL_PFR=y

# Intel PFR 3.0
CONFIG_SEAMLESS_UPDATE=y
CONFIG_CERBERUS_MCTP=y
CONFIG_CERBERUS_MCTP_TEST_ECHO=n
CONFIG_PFR_MCTP=y
CONFIG_PFR_SPDM_ATTESTATION=y
CONFIG_PFR_SPDM_RESPONDER=y

# Intel PFR 4.0
# MCTP over I3C
CONFIG_I3C=y
#CONFIG_I3C_SLAVE=y
#CONFIG_I3C_SLAVE_MQUEUE=y
CONFIG_I3C_ASPEED=y
CONFIG_PFR_MCTP_I3C=y

# CPLD Update
#CONFIG_INTEL_PFR_CPLD_UPDATE=y
#CONFIG_INTEL_SCM_CPLD_UPDATE_ONLY=y
```

## boards/arm/ast10x0_mp/Kconfig.board
```kconfig
# SPDX-License-Identifier: Apache-2.0
#
# Aspeed BIC AST10X0 board configuration
#
# Copyright (c) 2023 ASPEED Technology Inc.

config BOARD_AST10X0_MP
	bool "ASPEED AST10X0 Evaluation Board"
	depends on SOC_SERIES_AST10X0
```

## boards/arm/ast10x0_mp/Kconfig.defconfig
```kconfig
# SPDX-License-Identifier: Apache-2.0
#
# Aspeed BIC AST10X0 board configuration
#
# Copyright (c) 2023 ASPEED Technology Inc.

if BOARD_AST10X0_MP
config BOARD
	default "ast10x0_mp"
endif # BOARD_AST10X0_MP
```

## boards/arm/ast2700_dcscm/Kconfig.board
```kconfig
# SPDX-License-Identifier: Apache-2.0
#
# Aspeed AST2700 DCSCM PFR board configuration
#
# Copyright (c) 2024 ASPEED Technology Inc.

config BOARD_AST2700_DCSCM
	bool "ASPEED AST2700 DCSCM Evaluation Board"
	depends on SOC_AST1060
```

## boards/arm/ast2700_dcscm/Kconfig.defconfig
```kconfig
# SPDX-License-Identifier: Apache-2.0
#
# Aspeed AST2700 DCSCM PFR board configuration
#
# Copyright (c) 2024 ASPEED Technology Inc.

if BOARD_AST2700_DCSCM
config BOARD
	default "ast2700_dcscm"
endif # BOARD_AST2700_DCSCM
```

## lib/dmtf/Kconfig
```kconfig
# Copyright (c) 2023 ASPEED Technology Inc.
# SPDX-License-Identifier: MIT

config DMTF_LIBSPDM
	default n
	bool "DMTF LIBSPDM"

if DMTF_LIBSPDM

config DMTF_LIBSPDM_CONFIG_FILE
	string "Project based config file to replace spdm_lib_config.h"

endif # DMTF_LIBSPDM
```

## lib/lms/Kconfig
```kconfig
config MBEDTLS_LMS_C
        bool "LMS stateful-hash public-key signature scheme"
        depends on MBEDTLS_PSA_CRYPTO_C

config MBEDTLS_LMS_PRIVATE
        bool "LMS private-key operations and signing code"
        depends on MBEDTLS_LMS_C

config LMS_SHELL
        bool "Enable LMS sample code"
        default n
        depends on MBEDTLS_LMS_C
        depends on MBEDTLS
        depends on SHELL
        help
          Enable mbedtls LMS sample code.
```

## west.yml
```yaml
# Copyright (c) 2022 ASPEED Technology Inc.
# SPDX-License-Identifier: MIT

manifest:
  self:
    path: aspeed-zephyr-project

  remotes:
    - name: gerrit
      url-base: ssh://gerrit.aspeed.com:29418
    - name: github
      url-base: https://github.com/AspeedTech-BMC

  projects:
    - name: zephyr
      remote: gerrit
      revision: f947f6980189946957c03961d58bfa5049737cee
      import:
        name-whitelist:
          - mcumgr
          - cmsis
          - mcuboot
          - mbedtls
    - name: cerberus
      remote: gerrit
      revision: 797977bfa8c1adece243a59d74df7a1bdf3abae6
      path: middlewares/cerberus
    - name: mcuboot
      remote: gerrit
      revision: ce9bdf834557ee71b3ba87c32a16990f306ee8ee
      path: bootloader/mcuboot
```
