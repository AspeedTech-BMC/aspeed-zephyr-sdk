#include <dt-bindings/gpio/gpio.h>

/ {
	pfr_gpio_common {
		compatible = "aspeed,pfr-gpio-common";
		bmc-srst-ctrl-out-gpios = <&gpio0_m_p 5 0>; /* GPIO_M5 */
		bmc-extrst-ctrl-out-gpios = <&gpio0_e_h 26 0>; /* GPIO_H2 */
		bmc-rst-ind-in-gpios = <&gpio0_m_p 19 0>; /* GPIO_O3 */
		bmc-cpu1-mux-sel-out-gpios = <&gpio0_a_d 26 0>; /* GPIO_D2 */
		bic-rst-ind-in-gpios = <&gpio0_a_d 16 0>; /* GPIO_C0 */
		pch-rst-ctrl-out-gpios = <&gpio0_m_p 4 0>; /* GPIO_M4 */

		/* NOTICE:
		 * Normally, these two pin should be GPIO_ACTIVE_LOW, but currently this EVB
		 * doesn't produce correct power sequence by itself.
		 */
		rst-srst-bmc-in-gpios = <&gpio0_q_t 27 GPIO_ACTIVE_HIGH>; /* GPIO_T3 */
		rst-rsmrst-in-gpios = <&gpio0_q_t 24 GPIO_ACTIVE_HIGH>; /* GPIO_T0 */
	};
};

